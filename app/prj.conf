## CMakeLists.txt
```
#-------------------------------------------------------------------------------
# Zephyr Example Application
#
# Copyright (c) 2021 Nordic Semiconductor ASA
# SPDX-License-Identifier: Apache-2.0

cmake_minimum_required(VERSION 3.13.1)
find_package(Zephyr REQUIRED HINTS $ENV{ZEPHYR_BASE})

project(app LANGUAGES C)

zephyr_include_directories(src)

target_sources(app PRIVATE src/main.c)
target_sources(app PRIVATE src/controller.c)
target_sources(app PRIVATE src/game_object.c)
target_sources(app PRIVATE src/player.c)
target_sources(app PRIVATE src/screen.c)
target_sources(app PRIVATE src/screen_info.c)
target_sources(app PRIVATE src/coins.c)
target_sources(app PRIVATE src/sprites/SpritePlayer.c)
target_sources(app PRIVATE src/sprites/SpritePlayerFlipped.c)
target_sources(app PRIVATE src/sprites/SpriteRockTile.c)
target_sources(app PRIVATE src/sprites/SpriteDirtTile.c)
target_sources(app PRIVATE src/sprites/SpriteGrassTile.c)
target_sources(app PRIVATE src/sprites/SpriteCoin.c)
```

## prj.conf
```kconfig
# Copyright (c) 2021 Nordic Semiconductor ASA
# SPDX-License-Identifier: Apache-2.0
#
# This file contains selected Kconfig options for the application.

CONFIG_GPIO=y
CONFIG_PWM=y
CONFIG_SMF=y
CONFIG_HEAP_MEM_POOL_SIZE=4096

# Enable bluetooth as BLE central, GATT client
CONFIG_BT=y
CONFIG_BT_CENTRAL=y
CONFIG_BT_GATT_CLIENT=y

# Enable BLE error number conversion to strings
CONFIG_BT_HCI_ERR_TO_STR=y


# Enable touchscreen display
CONFIG_DISPLAY=y

# Enable light versatile graphics library
CONFIG_LVGL=y
CONFIG_LV_Z_MEM_POOL_SIZE=32768

# Increase size of stack to support LVGL
CONFIG_MAIN_STACK_SIZE=4096
```

## src/main.c
```c
/*
 * main.c
 */


#include <inttypes.h>

#include <zephyr/kernel.h>
#include <zephyr/sys/printk.h>
#include <zephyr/device.h>
#include <zephyr/drivers/display.h>

#include "LED.h"
#include "BTN.h"
#include "lv_data_obj.h"

#include "controller.h"
#include "game_object.h"
#include "player.h"
#include "screen.h"

#ifdef __INTELLISENSE__
  #include "drivers/BTN/BTN.h"
  #include "drivers/LED/LED.h"
#endif

#define SLEEP_MS 33        // 30 FPS

static const struct device *display_dev = DEVICE_DT_GET(DT_CHOSEN(zephyr_display));   // Find display device used by LVGL

void init_display() {
  if (!device_is_ready(display_dev)) {
    printk("Touchscreen device initialization error\n");
  }
  display_blanking_off(display_dev);      // Turn on screen
}

void update_game() {
  update_player();
}

int main(void) {
  if (0 > BTN_init()) {
    printk("Button initialization error\n");
    return 0;
  }
  if (0 > LED_init()) {
    printk("LED initialization error\n");
    return 0;
  }
  if (0 > init_bluetooth()) {
    printk("Bluetooth initialization error\n");
    return 0;
  }

  init_display();
  init_screen();

  while(1) {
    lv_timer_handler();
    update_game();

    k_msleep(SLEEP_MS);
  }

	return 0;
}
```

## src/coins.c
```c
#include "coins.h"
#include "screen.h"
#include <lvgl.h>

/*
 * Update the text displaying how many coins have been collected
 */
static void update_coin_counter();

extern const lv_image_dsc_t SpriteCoin;

// Objects involved in coin display
static lv_obj_t* coin_display;
static lv_obj_t* coins_label;
static lv_obj_t* coin_image;

// The current number of coins the player has collected
static int32_t coin_count = 0;

void update_coin_counter() {
    lv_label_set_text_fmt(coins_label, "%02d", coin_count);
}

void init_coin_display(lv_obj_t* game_screen) {
    // Create the transparent-gray component holding the coin display and place it in the top right
    coin_display = lv_obj_create(lv_layer_top());
    lv_obj_set_style_border_width(coin_display, 0, LV_PART_MAIN);
    lv_obj_set_style_bg_color(coin_display, lv_color_hex(0x000000), LV_PART_MAIN);
    lv_obj_set_style_bg_opa(coin_display, LV_OPA_50, LV_PART_MAIN);
    lv_obj_align(coin_display, LV_ALIGN_TOP_RIGHT, -COINS_LABEL_PX_MARGIN, COINS_LABEL_PX_MARGIN);

    // Size to hold children
    lv_obj_set_style_width(coin_display, LV_SIZE_CONTENT, LV_PART_MAIN);
    lv_obj_set_style_height(coin_display, LV_SIZE_CONTENT, LV_PART_MAIN);
    lv_obj_set_style_pad_hor(coin_display, COINS_LABEL_PX_HORIZONTAL_PADDING, LV_PART_MAIN);
    lv_obj_set_style_pad_ver(coin_display, COINS_LABEL_PX_VERTICAL_PADDING, LV_PART_MAIN);

    // Use flex layout to position children
    lv_obj_set_layout(coin_display, LV_LAYOUT_FLEX);
    lv_obj_set_flex_flow(coin_display, LV_FLEX_FLOW_ROW);
    lv_obj_set_style_pad_column(coin_display, 0, LV_PART_MAIN);
    

    // Create the white text displaying the number of coins collected
    coins_label = lv_label_create(coin_display);
    lv_obj_set_style_text_color(coins_label, lv_color_hex(0xffffff), LV_PART_MAIN);
    update_coin_counter();

    // Create the coin sprite image
    coin_image = lv_image_create(coin_display);
    lv_image_set_src(coin_image, &SpriteCoin);
    lv_obj_set_align(coin_image, LV_ALIGN_RIGHT_MID);
}

bool coin_callback(game_object_t* context) {
    // Remove the coin from the screen
    deactivate_game_object(context);
    context->exists = false;

    // Update the coin label
    coin_count += 1;
    update_coin_counter();

    // Don't produce a physical collision
    return false;   
}
```

## src/coins.h
```c
#pragma once

#include "game_object.h"
#include "lvgl.h"

#define COINS_LABEL_PX_MARGIN 10
#define COINS_LABEL_PX_HORIZONTAL_PADDING 5
#define COINS_LABEL_PX_VERTICAL_PADDING 4

/*
 * Create the component displaying the number of coins collected
 */
void init_coin_display();

/*
 * Destroy the coin `context` and increment the coin counter
 */
bool coin_callback(game_object_t* context);
```

## src/controller.c
```c
/*
 * controller.c
 */

#include "controller.h"

#include <errno.h>
#include <stddef.h>
#include <stdlib.h>
#include <zephyr/bluetooth/bluetooth.h>
#include <zephyr/bluetooth/conn.h>
#include <zephyr/bluetooth/gatt.h>
#include <zephyr/bluetooth/hci.h>
#include <zephyr/bluetooth/uuid.h>
#include <zephyr/kernel.h>
#include <zephyr/sys/byteorder.h>
#include <zephyr/sys/printk.h>
#include <zephyr/types.h>


/***************************************************************************************************************************************
 * Defines
 ***************************************************************************************************************************************/

#define PERIPHERAL_NAME "EiE 5666 Test GATT Server"
#define MIN_RSSI -50


/***************************************************************************************************************************************
 * Declare Local Functions
 ***************************************************************************************************************************************/

/*
 * Callback function for when a BLE advertisement is received.
 * If the connection to the controller (`ble_connection`) is not already established, checks if the advertised name matches `PERIPHERAL_NAME`, and
 * the signal strength (rssi) is greater than `MIN_RSSI`, it creates a connection and stops scanning for connection requests.
 */
static void ble_on_advertisement_received(const bt_addr_le_t* addr, int8_t rssi, uint8_t adv_type, struct net_buf_simple* buf);

/*
 * Copies name into `user_data` buffer if advertisement chunk `data` contains a device name and returns whether a name was found.
 */
static bool ble_get_adv_device_name_cb(struct bt_data* data, void* user_data);

/*
* Callback for when BLE device connection.
* Ensures the connection `conn` matches the connection that was selected, `ble_connection`.
* Clears the connection information if an error occurred.
* Discovers controller BLE service and characteristics.
*/
static void ble_on_device_connected(struct bt_conn* conn, uint8_t err);

/*
 * Callback for BLE device is disconnection, clears connection information (`ble_connection`)
 */
static void ble_on_device_disconnected(struct bt_conn* conn, uint8_t reason);

/*
 * Callback to discover GATT characteristics and register notifications.
 * Checks if `attr` matches each of the expected characteristic UUIDs, in which case it sets `next_subscribe_params` sets next subscribe params to corresponding variable.
 * Whenever `attr` is a CCC descriptor, sets up notifications for `next_subscribe_params` (if any), thus enabling notifications for the last characteristic.
 * Continues GATT discovery (return BT_GATT_ITER_CONTINUE) until end of the tree (a NULL `attr`) is reached (return BT_GATT_ITER_STOP)
 * Expected to be used with bt_gatt_discover to scan the entire GATT tree.  
 */
static uint8_t gatt_characteristic_discover(struct bt_conn* conn, const struct bt_gatt_attr* attr, struct bt_gatt_discover_params* params);

/*
 * Callback for notifications of button updates. Expects a single byte of `data` representing a bitmask for whether each button is on.
 * Updates `last_button_states` and `button_events` so button API functions can receive appropriate updates.
 */
static uint8_t button_update_func(struct bt_conn* conn, struct bt_gatt_subscribe_params* params, const void* data, uint16_t length);

/*
 * Callback for notifications of joystick updates
 */
static uint8_t joystick_update_func(struct bt_conn* conn, struct bt_gatt_subscribe_params* params, const void* data, uint16_t length);

/***************************************************************************************************************************************
 * Variable Definitions
 ***************************************************************************************************************************************/

// The UUIDs for services and characteristics
static const struct bt_uuid_128 BUTTON_CHARACTERISTIC_ID = BT_UUID_INIT_128(BT_UUID_128_ENCODE(0x03A57D8B, 0x8092, 0xF3E6, 0x5B9D, 0x2002757871D3));
static const struct bt_uuid_128 JOYSTICK_CHARACTERISTIC_ID = BT_UUID_INIT_128(BT_UUID_128_ENCODE(0x08154e46, 0x99b7, 0x5ea3, 0xd6d7, 0xc983e5568d64));
static const struct bt_uuid_16 CCC_UUID = BT_UUID_INIT_16(BT_UUID_GATT_CCC_VAL);      // UUID for any GATT CCC notify attribute

static int err;                                                             // The last BLE error code received
static struct bt_conn* ble_connection = NULL;                               // The BLE connection to the controller
static struct bt_gatt_discover_params discover_params;                      // Parameters for asynchronous GATT characteristic discovery, must remain valid until discovery is complete

static struct bt_gatt_subscribe_params *next_subscribe_params = NULL;                                   // CCC subscription parameters for current characteristic, during discovery
static struct bt_gatt_subscribe_params button_subscribe_params = {.notify = button_update_func};        // CCC subscription parameters for button characteristic
static struct bt_gatt_subscribe_params joystick_subscribe_params = {.notify = joystick_update_func};    // CCC subscription parameters for joystick characteristic

static uint8_t last_button_states = 0;          // Bitmask representing last state of each button
static uint8_t button_events = 0;               // Bitmask representing whether event occurred on each button

 // Global variable for current state of joystick
joystick_t joystick_state = {
    .h = JOYSTICK_HORIZONTAL_NEUTRAL,
    .v = JOYSTICK_VERTICAL_NEUTRAL
};                      

/***************************************************************************************************************************************
 * Configure BLE
 ***************************************************************************************************************************************/

 // Register device connected and disconnected functions with BLE module
BT_CONN_CB_DEFINE(conn_callbacks) = {
  .connected = ble_on_device_connected,
  .disconnected = ble_on_device_disconnected
};


/***************************************************************************************************************************************
 * BLE Local Function Definitions
 ***************************************************************************************************************************************/

static void ble_on_advertisement_received(const bt_addr_le_t* addr, int8_t rssi, uint8_t adv_type, struct net_buf_simple* buf) {
    if (ble_connection != NULL) {                                               // If a connection has already been or is being established
        printk("Advertisement ignored - BLE connection already established\n");
        return;                                                                         // Ignore the advertisement
    }
    
    char mac_address[BT_ADDR_LE_STR_LEN];                                       // Buffer to hold MAC address
    bt_addr_le_to_str(addr, mac_address, sizeof(mac_address));                  // Extract MAC address into buffer

    char name[32] = {'\0'};                                                     // Buffer to hold the device name                                                              
    bt_data_parse(buf, ble_get_adv_device_name_cb, name);                       // Extract device name from advertising data, if present

    printk("Received advertisement from %s (device name: %s)\n", mac_address, name);

    if (strcmp(name, PERIPHERAL_NAME) != 0) {                                   // If the device name doesn't match the set PERIPHERAL_NAME
        return;                                                                         // Ignore the advertisement
    }

    if (rssi < -50) {                                                           // If the connection strength is very weak
        printk("Connection strength too weak, ignoring advertisement (rssi=%d)", rssi);
        return;                                                                         // Ignore the advertisement
    }

    bt_le_scan_stop();                                                                                  // Stop scanning advertisements
    err = bt_conn_le_create(addr, BT_CONN_LE_CREATE_CONN, BT_LE_CONN_PARAM_DEFAULT, &ble_connection);   // Create a connection, storing information in `ble_connection`
    if (err) {                                                                                          // If the connection failed
        printk("Error creating BLE connection - %s\n", bt_hci_err_to_str(err));
        ble_connection = NULL;                                                                          // Clear the connection information
        return;
    }

    printk("Connection Established\n");
}

static bool ble_get_adv_device_name_cb(struct bt_data* data, void* user_data) {
    if (data->type == BT_DATA_NAME_COMPLETE || 
        data->type == BT_DATA_NAME_SHORTENED)                                   // If the data type is a name
    {
        memcpy(user_data, data->data, data->data_len);                               // Copy the name into `user_data`
        ((char*)user_data)[data->data_len] = '\0';                                   // Make the name a cstring by adding a null terminator
        return false;                                                                // Stop parsing
    }
    return true;                                                               // Continue parsing this advertising packet
}

static void ble_on_device_connected(struct bt_conn* conn, uint8_t err) {
    if (conn == ble_connection) {                                               // If the connection is actually the one we tried to make (to the controller)
        
        if(err != 0) {                                                                  // If the connection failed
            bt_conn_unref(conn);                                                            // Clear the connection information
            ble_connection = NULL;                                                          // Indicate no connection is currently made
            return;
        }

        char mac_address[BT_ADDR_LE_STR_LEN];                                          // Define a buffer to hold the MAC address
        bt_addr_le_to_str(bt_conn_get_dst(conn), mac_address, sizeof(mac_address));     // Copy destination MAC address into buffer
        printk("BLE connected to %s\n", mac_address);

        discover_params.uuid = NULL;                                         // Search for any UUID
        discover_params.start_handle = BT_ATT_FIRST_ATTRIBUTE_HANDLE;        // Search from first GATT attribute
        discover_params.end_handle = BT_ATT_LAST_ATTRIBUTE_HANDLE;           // To the last GATT attribute
        discover_params.func = gatt_characteristic_discover;                 // Process attributes with gatt_characteristic_discover
        discover_params.type = BT_GATT_DISCOVER_ATTRIBUTE;                   // Search for any attribute

        err = bt_gatt_discover(ble_connection, &discover_params);           // Setup GATT attributes
        if (err != 0) {
            printk("Service discovery queueing failed (err - %u)\n", err);
            return;
        }
        printk("Service discovery queueing successful\n");
    }
}

static void ble_on_device_disconnected(struct bt_conn* conn, uint8_t reason) {
    if (conn == ble_connection) {                                               // If the *controller* connection was lost
        bt_conn_unref(conn);                                                            // Clear connection information
        ble_connection = NULL;                                                          // Indicate no connection is currently made
        printk("BLE disconnected - %s", bt_hci_err_to_str(reason));
    }
}

static uint8_t gatt_characteristic_discover(struct bt_conn* conn, const struct bt_gatt_attr* attr, struct bt_gatt_discover_params* params) {
    if (attr == NULL) {                                                             // If the last attribute has been reached
        printk("Reached final characteristic\n");
        return BT_GATT_ITER_STOP;                                                       // Stop searching attributes
    }

    char uuid_buffer[64] = {0};
    bt_uuid_to_str(attr->uuid, uuid_buffer, 64);
    printk("Discovering characteristic (handle - %d, uuid - %s)\n", attr->handle, uuid_buffer);
    
    if (0 == bt_uuid_cmp(attr->uuid, &CCC_UUID.uuid)) {                     // If CCC descriptor
        if (next_subscribe_params != NULL) {                                    // If the previous characteristic set to be subscribed
            next_subscribe_params->value = BT_GATT_CCC_NOTIFY;                      // Configure as notifications
            next_subscribe_params->ccc_handle = attr->handle;                       // Set subscription handle (GATT index)

            err = bt_gatt_subscribe(conn, next_subscribe_params);                  // Subscribe to characteristic
            if (err != 0) {
                printk("GATT notify subscription failed\n");
            }
            next_subscribe_params = NULL;                                           // Indicate subscription is complete 
            printk("Subscription to characteristic successful\n");
        }
    } else if (0 == bt_uuid_cmp(attr->uuid, &BUTTON_CHARACTERISTIC_ID.uuid)) {      // If matches button characteristic
        printk("Button characteristic discovered\n");
        next_subscribe_params = &button_subscribe_params;                               // Setup subscription, for when CCC found
        next_subscribe_params->value_handle = attr->handle;                                 // Set handle to retrieve / set this attribute's value
    } else if (0 == bt_uuid_cmp(attr->uuid, &JOYSTICK_CHARACTERISTIC_ID.uuid)) {    // If matches joystick characteristic
        printk("Joystick characteristic discovered\n");
        next_subscribe_params = &joystick_subscribe_params;                             // Setup subscription, for when CCC found
        next_subscribe_params->value_handle = attr->handle;                                 // Set handle to retrieve / set this attribute's value
    }

    return BT_GATT_ITER_CONTINUE;                                                   // Continue discovering attributes
}


uint8_t init_bluetooth() {
    err = bt_enable(NULL);                                                      // Initialize bluetooth
    if (err) {
        printk("Bluetooth init failed (err = %s)\n", bt_hci_err_to_str(err));
        return err;
    } else {
        printk("Bluetooth initialized\n");
    }

    err = bt_le_scan_start(BT_LE_SCAN_ACTIVE, ble_on_advertisement_received);         // Start scanning for advertisements

    return err;               // Indicate no error occurred
}


/***************************************************************************************************************************************
 * Notification Callback Function Definitions
 ***************************************************************************************************************************************/

static uint8_t button_update_func(struct bt_conn* conn, struct bt_gatt_subscribe_params* params, const void* data, uint16_t length) {
    if (data == NULL) {                                                     // No data call indicates notification cancelled by GATT server
        printk("Button Characteristic Unsubscribed\n");
        return BT_GATT_ITER_STOP;                                               // Stop looking for notifications
    }

    uint8_t new_button_states = *((uint8_t*) data);                         // Extract boolean values for whether each button was pressed from data
    button_events |= last_button_states ^ new_button_states;                // Register new button events for each value that changed
    last_button_states = new_button_states;                                 // Update stored button states

    return BT_GATT_ITER_CONTINUE;                                           // Continue receiving button notifications
}

static uint8_t joystick_update_func(struct bt_conn* conn, struct bt_gatt_subscribe_params* params, const void* data, uint16_t length) {
    if (data == NULL) {                                                     // No data call indicates notification cancelled by GATT server
        printk("Joystick Characteristic Unsubscribed\n");
        return BT_GATT_ITER_STOP;                                               // Stop looking for notifications
    }

    // Update current joystick state - each byte should be either 0, 1 or 2
    joystick_state.h = ((uint8_t*) data)[0];
    joystick_state.v = ((uint8_t*) data)[1];

    return BT_GATT_ITER_CONTINUE;                                           // Continue receiving joystick notifications
}


/***************************************************************************************************************************************
 * Global API Function Definitions
 ***************************************************************************************************************************************/

bool button_check_clear_pressed(uint8_t button_id) {
    uint8_t button_index_mask = 1 << button_id;                             // Mask for bit where button's information is
    if ((button_events & button_index_mask) &&                              // If a button event occurred at that index
        (last_button_states & button_index_mask))                           // And that button is currently down (1)
    {                         
        button_events &= ~button_index_mask;                                    // Clear the button event
        return true;                                                            // Return that the button was pressed
    }
    return false;                                                           // Return that the button was *not* pressed
}

bool button_check_clear_released(uint8_t button_id) {
    uint8_t button_index_mask = 1 << button_id;                             // Mask for bit where button's information is
    if ((button_events & button_index_mask) &&                              // If a button event occurred at that index
        !(last_button_states & button_index_mask))                          // And the button is currently up (0)
    {
        button_events &= ~button_index_mask;                                    // Clear the button event
        return true;                                                            // Return that the button was released
    }
    return false;                                                           // Return that the button was *not* released
}

bool button_check_held(uint8_t button_id) {
    uint8_t button_index_mask = 1 << button_id;                             // Mask for bit where button's information is
    return (last_button_states & button_index_mask) != 0;                  // Return whether button is currently down (1)
}
```

## src/controller.h
```c
#pragma once

#include <inttypes.h>
#include <stdbool.h>

#define BUTTON_ID_A 0
#define BUTTON_ID_B 1
#define BUTTON_ID_X 2
#define BUTTON_ID_Y 3

// Numbers representing different positions for horizontal joystick position
typedef enum {
    JOYSTICK_LEFT = 0,
    JOYSTICK_HORIZONTAL_NEUTRAL = 1,
    JOYSTICK_RIGHT = 2
} joystick_horizontal_t;

// Numbers representing different positions of vertical joystick position
typedef enum {
    JOYSTICK_UP = 0,
    JOYSTICK_VERTICAL_NEUTRAL = 1,
    JOYSTICK_DOWN = 2
} joystick_vertical_t;

// Joystick position on horizontal and vertical axes
typedef struct {
    joystick_horizontal_t h;
    joystick_vertical_t v;
} joystick_t;

extern joystick_t joystick_state;           // Current state of the joystick, for global access

/*
 * Begins scanning for the BLE central, triggering a sequence of asynchronous calls that setup the connection and
 * allows different characteristic API calls to be used.
 */
uint8_t init_bluetooth();

/*
 * Returns whether the button `button_id` has been pressed (transition from being up to being down) since this function was last called.
 */
bool button_check_clear_pressed(uint8_t button_id);

/*
 * Returns whether the button `button_id` has been released
 */
bool button_check_clear_released(uint8_t button_id);

/*
 * Returns whether the button `button_id` is currently held down
 */
bool button_check_held(uint8_t button_id);
```

## src/game_object.c
```c
#include "game_object.h"
#include <zephyr/kernel.h>


void activate_game_object(game_object_t* obj, lv_obj_t* screen) {
  // If object doesn't still exist, ignore it
  if (obj->exists) {
    // Clear the old image, if the object is already active
    deactivate_game_object(obj);

    // Create the image representing the game object
    lv_obj_t* image = lv_image_create(screen);
    lv_obj_set_pos(image, obj->pos.x >> SUBPIXEL_SHIFT, obj->pos.y >> SUBPIXEL_SHIFT);
    lv_obj_set_size(image, obj->w >> SUBPIXEL_SHIFT, obj->h >> SUBPIXEL_SHIFT);
    lv_image_set_src(image, obj->sprite);
    lv_image_set_inner_align(image, LV_IMAGE_ALIGN_TILE);   // Enable tile mosaic
    obj->image = image;
  }
}

void deactivate_game_object(game_object_t* obj) {
  // Clear the LVGL resources for the game object's sprite
  if (obj->image != NULL) {
    lv_obj_delete(obj->image);
    obj->image = NULL;
  }
}

void set_game_object_sprite(game_object_t* obj, const lv_image_dsc_t* sprite) {
  if (sprite != obj->sprite) {
    obj->sprite = sprite;
    if (obj->image != NULL) {
      lv_image_set_src(obj->image, sprite);
    }
  }
}

bool check_collision(game_object_t* obj1, game_object_t* obj2) {
  // If either object has been destroyed, it cannot produce collisions
  if (!obj1->exists || !obj2->exists) {
    return false;
  }

  // Check if the hitbox's horizontal ranges overlap
  bool is_right_of_left        = obj1->pos.x + obj1->w > obj2->pos.x;
  bool is_left_of_right        = obj1->pos.x < obj2->pos.x + obj2->w;
  bool within_horizontal_range = is_right_of_left && is_left_of_right;

  // Check if the hitbox's vertical ranges overlap
  bool is_below_top            = obj1->pos.y + obj1->h > obj2->pos.y;
  bool is_above_bottom         = obj1->pos.y < obj2->pos.y + obj2->h;
  bool within_vertical_range   = is_below_top && is_above_bottom;

  if (within_horizontal_range && within_vertical_range) {
    bool collision = true;

    // Trigger object collision callbacks
    if (obj1->collision_callback != NULL) {
      collision &= obj1->collision_callback(obj1);
    }
    if (obj2->collision_callback != NULL) {
      collision &= obj2->collision_callback(obj2);
    }
    return collision;
  } else {
    return false;
  }
}
```

## src/game_object.h
```c
#pragma once

#include <inttypes.h>
#include <lvgl.h>

#ifdef __INTELLISENSE__
  #include <modules/lib/gui/lvgl/lvgl.h>
#endif

// The first 8 bits of each position value represents a subpixel value, allowing for clean movement
// Values should be shifted by SUBPIXEL shift before being passed into LVGL
#define SUBPIXEL_SHIFT 8

// Represents a vector with components on the x and y axes
struct __vector2_t {
  int32_t x;
  int32_t y;
} typedef vector2_t;

// Represents an object within the game, which is displayed on the screen with the LVGL image `sprite` at (`pos.x`, `pos.y`)
struct __game_object_t {
  lv_obj_t* image;
  const lv_image_dsc_t* sprite;
  vector2_t pos;
  int32_t w;
  int32_t h;
  bool exists;
  bool (*collision_callback)(struct __game_object_t* context);
} typedef game_object_t;

/*
 * Display the game object on `screen`
 */
void activate_game_object(game_object_t* obj, lv_obj_t* screen);

/*
 * Stop displaying the game object and free lvgl resources
 */
void deactivate_game_object(game_object_t* obj);

/*
 * Update `obj`'s image to display `sprite`, if it different then it's current sprite
 */
void set_game_object_sprite(game_object_t* obj, const lv_image_dsc_t* sprite);

/*
 * Returns whether the hitboxes of `obj1` and `obj2` are currently overlapping
 */
bool check_collision(game_object_t* obj1, game_object_t* obj2);
```

## src/my_state_machine.c
```c
#include <zephyr/smf.h>

#include "BTN.h"
#include "LED.h"
#include "my_state_machine.h"

/*----------------------------------------------------------------------------------------------------------
 * Function Prototypes
 *--------------------------------------------------------------------------------------------------------*/

static void S1_enter(void* o);
static void S2_enter(void* o);
static void S3_enter(void* o);
static void S4_enter(void* o);

static enum smf_state_result S0_run(void* o);
static enum smf_state_result S1_run(void* o);
static enum smf_state_result S2_run(void* o);
static enum smf_state_result S3_run(void* o);
static enum smf_state_result S4_run(void* o);

static void clear_LEDs(void* o);

/*----------------------------------------------------------------------------------------------------------
 * Typedefs
 *--------------------------------------------------------------------------------------------------------*/

enum led_state_machine_states {
    S0,
    S1,
    S2,
    S3,
    S4
};

typedef struct {
    struct smf_ctx ctx;

    uint16_t count;
} led_state_object_t;


/*----------------------------------------------------------------------------------------------------------
 * Local Variables
 *--------------------------------------------------------------------------------------------------------*/

static const struct smf_state led_states[] = {
    [S0] = SMF_CREATE_STATE(NULL, S0_run, clear_LEDs, NULL, NULL),
    [S1] = SMF_CREATE_STATE(S1_enter, S1_run, clear_LEDs, NULL, NULL),
    [S2] = SMF_CREATE_STATE(S2_enter, S2_run, clear_LEDs, NULL, NULL),
    [S3] = SMF_CREATE_STATE(S3_enter, S3_run, clear_LEDs, NULL, NULL),
    [S4] = SMF_CREATE_STATE(S4_enter, S4_run, clear_LEDs, NULL, NULL)
};

static led_state_object_t led_state_object;

/*----------------------------------------------------------------------------------------------------------
 * Local Functions
 *--------------------------------------------------------------------------------------------------------*/

static enum smf_state_result S0_run()
{
    if (BTN_check_clear_pressed(BTN0))
    {
        smf_set_state(SMF_CTX(&led_state_object), &led_states[S1]);
    }
    return SMF_EVENT_HANDLED;
}

static void S1_enter(void* o)
{
    LED_blink(LED0, 4);
}

static enum smf_state_result S1_run()
{
    if (BTN_check_clear_pressed(BTN1))
    {
        smf_set_state(SMF_CTX(&led_state_object), &led_states[S2]);
    }
    if (BTN_check_clear_pressed(BTN2))
    {
        smf_set_state(SMF_CTX(&led_state_object), &led_states[S4]);
    }
    if (BTN_check_clear_pressed(BTN3))
    {
        smf_set_state(SMF_CTX(&led_state_object), &led_states[S0]);
    }
    return SMF_EVENT_HANDLED;
}



static void S2_enter(void* o)
{
    LED_set(LED0, 1);
    LED_set(LED2, 1);
}

static enum smf_state_result S2_run()
{
    if (BTN_check_clear_pressed(BTN3))
    {
        smf_set_state(SMF_CTX(&led_state_object), &led_states[S0]);
    }
    else if (led_state_object.count == 1000)
    {
            smf_set_state(SMF_CTX(&led_state_object), &led_states[S3]);
    }
    led_state_object.count++;
    return SMF_EVENT_HANDLED;
}

static void S3_enter(void* o)
{
    LED_set(LED1, 1);
    LED_set(LED3, 1);

}

static enum smf_state_result S3_run()
{
    if (BTN_check_clear_pressed(BTN3))
    {
        smf_set_state(SMF_CTX(&led_state_object), &led_states[S0]);
    }
    else if (led_state_object.count == 2000)
    {
        smf_set_state(SMF_CTX(&led_state_object), &led_states[S2]);
    }
    led_state_object.count++;
    return SMF_EVENT_HANDLED;
}

static void S4_enter(void* o)
{
    LED_blink(LED0, 16);
    LED_blink(LED1, 16);
    LED_blink(LED2, 16);
    LED_blink(LED3, 16);
}

static enum smf_state_result S4_run()
{
    if (BTN_check_clear_pressed(BTN3))
    {
        smf_set_state(SMF_CTX(&led_state_object), &led_states[S0]);
    }
    return SMF_EVENT_HANDLED;
}

static void clear_LEDs()
{
    LED_set(LED0, 0);
    LED_set(LED1, 0);
    LED_set(LED2, 0);
    LED_set(LED3, 0);
    led_state_object.count = 0;
}


/*----------------------------------------------------------------------------------------------------------
 * Global Functions
 *--------------------------------------------------------------------------------------------------------*/

void state_machine_init()
{
    led_state_object.count = 0;
    smf_set_initial(SMF_CTX(&led_state_object), &led_states[S0]);
}

int state_machine_run()
{
    return smf_run_state(SMF_CTX(&led_state_object));
}
```

## src/player.c
```c
#include "player.h"
#include "screen.h"


/***************************************************************************************************************************************
 * Variables
 ***************************************************************************************************************************************/

 // Player Sprite Sources
extern const lv_image_dsc_t SpritePlayer;
extern const lv_image_dsc_t SpritePlayerFlipped;

// Player object
static player_t player = {
  {NULL, &SpritePlayer, {PLAYER_STARTING_SUBPIXEL_X, PLAYER_STARTING_SUBPIXEL_Y}, PLAYER_SUBPIXEL_WIDTH, PLAYER_SUBPIXEL_HEIGHT, true, NULL},
  {0, 0}, 
  PLAYER_FALLING,
  COYOTE_FRAMES + 1   // Don't allow the player to immediately jump,
};


/***************************************************************************************************************************************
 * Local Function Declarations
 ***************************************************************************************************************************************/

/*
 * Set player velocity based on player's state and user inputs
 */
void update_player_velocity();


/*
 * Move player, checking for collisions with `colliders`
 */
void update_player_location();


/***************************************************************************************************************************************
 * Local Function Definitions
 ***************************************************************************************************************************************/

void update_player_velocity() {
    // Apply force of gravity
  player.vel.y += SUBPIXEL_GRAVITY;

  // Move player based on joystick direction
  switch (joystick_state.h) {
    case JOYSTICK_LEFT:
      player.vel.x = -PLAYER_HORIZONTAL_SUBPIXEL_SPEED;
      set_game_object_sprite(&player.obj, &SpritePlayerFlipped);
      break;
    case JOYSTICK_HORIZONTAL_NEUTRAL:
      player.vel.x = 0;
      break;
    case JOYSTICK_RIGHT:
      set_game_object_sprite(&player.obj, &SpritePlayer);
      player.vel.x = PLAYER_HORIZONTAL_SUBPIXEL_SPEED;
      break;
  }

  // Update player depending on their state and determine if they can jump
  bool can_jump = false;
  switch(player.state) {
    case PLAYER_GROUNDED:
      can_jump = true;
      break;
    case PLAYER_FALLING:
      if (player.frames_airborne <= COYOTE_FRAMES) {
        can_jump = true;
      }
      player.frames_airborne += 1;
      break;
    case PLAYER_JUMPING:
      // For variable jump height, check if the player releases the jump button early
      if (button_check_clear_released(JUMP_BUTTON)) {
        // If the player is still moving upwards, half their remaining velocity
        if (player.vel.y < 0) {
          player.vel.y /= 2;
        }
      }
      player.frames_airborne += 1;
      break;
  }

  if (can_jump) {
    if (button_check_clear_pressed(BUTTON_ID_B)) {
      player.state = PLAYER_JUMPING;
      player.vel.y = -JUMP_SPEED;
    }
  }
}

void update_player_location() {
  screen_t* active_screen = get_active_screen();
  if (active_screen == NULL) {
    return;
  }

  // Update player x position ignoring collisions
  player.obj.pos.x += player.vel.x;

  // Check for collisions after applying horizontal motion
  for (int i = 0; i < active_screen->num_objects; i++) {
    game_object_t* obj = &active_screen->objects[i];
    if (check_collision(&player.obj, obj)) {
      if (player.vel.x > 0) {                        // If moving right, collision with the left wall
        player.obj.pos.x = obj->pos.x - player.obj.w;
      }
      else {                                        // Collision with right wall
        player.obj.pos.x = obj->pos.x + obj->w;
      }
    }
  }

  // If player passes screen boundary, move to next screen
  if (player.obj.pos.x < 0) {
    shift_screen(0, -1);
    player.obj.pos.x += SCREEN_SUBPIXEL_WIDTH - TILE_SUBPIXEL_WIDTH - SCREEN_SUBPIXEL_LEFT_EXTRA - SCREEN_SUBPIXEL_RIGHT_EXTRA;
    active_screen = get_active_screen();
  }
  else if (player.obj.pos.x > SCREEN_SUBPIXEL_WIDTH - player.obj.w) {
    shift_screen(0, 1);
    player.obj.pos.x += -SCREEN_SUBPIXEL_WIDTH + TILE_SUBPIXEL_WIDTH + SCREEN_SUBPIXEL_LEFT_EXTRA + SCREEN_SUBPIXEL_RIGHT_EXTRA;
    active_screen = get_active_screen();
  }
  
  // Update player y position ignoring collisions
  player.obj.pos.y += player.vel.y;

  // Check for collisions after applying vertical motion
  bool is_grounded = false;
  for (int i = 0; i < active_screen->num_objects; i++) {
    game_object_t* obj = &active_screen->objects[i];
    if (check_collision(&player.obj, obj)) {
      if (player.vel.y > 0) {             // If moving down, must be standing on the ground
        is_grounded = true;
        player.obj.pos.y = obj->pos.y - player.obj.h;
      }
      else {                             // Hitting the ceiling
        player.vel.y = 0;
        player.obj.pos.y = obj->pos.y + obj->h;
      }
    }
  }

  // If player passes screen boundary, move to next screen
  if (player.obj.pos.y < 0) {
    shift_screen(-1, 0);
    player.obj.pos.y += SCREEN_SUBPIXEL_HEIGHT - SCREEN_SUBPIXEL_TOP_EXTRA - SCREEN_SUBPIXEL_BOTTOM_EXTRA;
  }
  else if (player.obj.pos.y > SCREEN_SUBPIXEL_HEIGHT - player.obj.h) {
    shift_screen(1, 0);
    player.obj.pos.y += -SCREEN_SUBPIXEL_HEIGHT + SCREEN_SUBPIXEL_TOP_EXTRA + SCREEN_SUBPIXEL_BOTTOM_EXTRA;
  }
  
 
  if (is_grounded) {                              // Update player state if they are now standing on the ground
    player.state = PLAYER_GROUNDED;
    player.frames_airborne = 0;
    player.vel.y = 0;
  } else if (player.state == PLAYER_GROUNDED) {   // Update player state if they are no longer standing on the ground
    player.state = PLAYER_FALLING;
  }
}

/***************************************************************************************************************************************
 * Global Function Definitions
 ***************************************************************************************************************************************/

void init_player(lv_obj_t* game_screen) {
  activate_game_object(&player.obj, game_screen);
}

void update_player() {
  update_player_velocity();
  update_player_location();

  // Update player sprite position
  lv_obj_set_pos(player.obj.image, player.obj.pos.x >> SUBPIXEL_SHIFT, player.obj.pos.y >> SUBPIXEL_SHIFT);
}
```

## src/player.h
```c
#pragma once

#include "game_object.h"
#include "controller.h"

// Starting location
#define PLAYER_STARTING_SUBPIXEL_X TILE_SUBPIXEL_WIDTH
#define PLAYER_STARTING_SUBPIXEL_Y (TILE_SUBPIXEL_HEIGHT * 10)

// Constants controlling player motion
#define SUBPIXEL_GRAVITY 128
#define PLAYER_HORIZONTAL_SUBPIXEL_SPEED 768
#define JUMP_SPEED 1920
#define FULL_JUMP_DURATION 5 
#define COYOTE_FRAMES 3
#define JUMP_BUTTON BUTTON_ID_B

// Constants based on player sprite
#define PLAYER_SUBPIXEL_WIDTH (11 << SUBPIXEL_SHIFT)
#define PLAYER_SUBPIXEL_HEIGHT (15 << SUBPIXEL_SHIFT)

enum __player_state_t {
  PLAYER_GROUNDED,
  PLAYER_FALLING,
  PLAYER_JUMPING
} typedef player_state_t;

struct __player_t {
  game_object_t obj;
  vector2_t vel;
  player_state_t state;
  int16_t frames_airborne;
} typedef player_t;

/*
 * Initialize the player, placing its sprite on `game_screen`
 */
void init_player(lv_obj_t* game_screen);

/*
 * Update the players location and perform collisions for a particular frame
 */
void update_player();
```

## src/screen.c
```c
#include "screen.h"
#include "player.h"
#include "screen_info.h"
#include "coins.h"

/***************************************************************************************************************************************
 * Variables
 ***************************************************************************************************************************************/

// Import sprites
extern const lv_image_dsc_t SpriteRockTile;
extern const lv_image_dsc_t SpriteGrassTile;
extern const lv_image_dsc_t SpriteDirtTile;

// LVGL screen for the game
static lv_obj_t* game_screen;

// Grid of available screens
extern screen_t *screens[NUM_SCREEN_ROWS][NUM_SCREEN_COLS];
static int32_t current_screen_row;
static int32_t current_screen_col;

// Currently active screen
static screen_t* current_screen = NULL;

/***************************************************************************************************************************************
 * Global Function Definitions
 ***************************************************************************************************************************************/

void init_screen() {
  game_screen = lv_obj_create(NULL);                                                            // Create LVGL screen
  init_player(game_screen);                                                                     // Initialize the player
  lv_obj_set_style_bg_color(game_screen, lv_color_hex(SCREEN_BACKGROUND_COLOR), LV_PART_MAIN);  // Set background color
  lv_obj_remove_flag(game_screen, LV_OBJ_FLAG_SCROLLABLE);                                      // Don't display scroll bars
  activate_screen(STARTING_SCREEN_ROW, STARTING_SCREEN_COL);                                    // Activate the initial screen
  lv_screen_load(game_screen);                                                                  // Put screen on display
  init_coin_display(game_screen);
}

void activate_screen(int32_t row, int32_t col) {
  // Deactivate objects on the old screen
  if (current_screen != NULL){
    for (int i = 0; i < current_screen->num_objects; i++) {
      deactivate_game_object(&current_screen->objects[i]);
    }
  }
  
  // Change the currently active screen
  current_screen_row = row;
  current_screen_col = col;
  current_screen = screens[row][col];

  // Activate objects on the new screen
  for (int i = 0; i < current_screen->num_objects; i++) {
    activate_game_object(&current_screen->objects[i], game_screen);
  }
}

void shift_screen(int32_t row_delta, int32_t col_delta) {
  activate_screen(current_screen_row + row_delta, current_screen_col + col_delta);
}

screen_t* get_active_screen() {
  return current_screen;
}
```

## src/screen.h
```c
#pragma once

#include "game_object.h"
#include "screen_info.h"

// The hex color for the screen's background
#define SCREEN_BACKGROUND_COLOR 0x3c88cf    

// Pixel width and height of screen
#define SCREEN_PX_WIDTH 320
#define SCREEN_PX_HEIGHT 240

// Subpixel width and height of screen
#define SCREEN_SUBPIXEL_WIDTH (SCREEN_PX_WIDTH << SUBPIXEL_SHIFT)
#define SCREEN_SUBPIXEL_HEIGHT (SCREEN_PX_HEIGHT << SUBPIXEL_SHIFT)

// Initial screen to display
#define STARTING_SCREEN_ROW 3
#define STARTING_SCREEN_COL 3

// Pixel width and height for tiles composing world
#define TILE_PX_WIDTH 15
#define TILE_PX_HEIGHT 15

// Subpixel width and height for tiles composing world
#define TILE_SUBPIXEL_WIDTH (TILE_PX_WIDTH << SUBPIXEL_SHIFT)
#define TILE_SUBPIXEL_HEIGHT (TILE_PX_HEIGHT << SUBPIXEL_SHIFT)

// Amount of pixels to hide past the edge of the screen
#define SCREEN_PX_LEFT_HIDDEN 13
#define SCREEN_PX_RIGHT_HIDDEN 12
#define SCREEN_PX_BOTTOM_HIDDEN 7
#define SCREEN_PX_TOP_HIDDEN 8

// Margin of extra subpixels to for tiles on edge of screen
#define SCREEN_SUBPIXEL_LEFT_EXTRA (TILE_SUBPIXEL_WIDTH - (SCREEN_PX_LEFT_HIDDEN << SUBPIXEL_SHIFT))
#define SCREEN_SUBPIXEL_RIGHT_EXTRA (TILE_SUBPIXEL_WIDTH - (SCREEN_PX_RIGHT_HIDDEN << SUBPIXEL_SHIFT))
#define SCREEN_SUBPIXEL_BOTTOM_EXTRA (TILE_SUBPIXEL_WIDTH - (SCREEN_PX_BOTTOM_HIDDEN << SUBPIXEL_SHIFT))
#define SCREEN_SUBPIXEL_TOP_EXTRA (TILE_SUBPIXEL_WIDTH - (SCREEN_PX_TOP_HIDDEN << SUBPIXEL_SHIFT))

// The maximum number of game objects appearing on a screen
#define MAX_NUM_GAME_OBJECTS 200            

// An array of game objects, with associated length
struct __game_object_list_t {
  uint32_t len;
  game_object_t* game_objects;
} typedef game_object_list_t;

/*
 * Initialize and activate the game screen
 */
void init_screen();

/*
 * Set screen (`row`, `col`) as the active screen, destroying the objects on the old screen
 */
void activate_screen(int32_t row, int32_t col);

/*
 * Shift the active screen by `row_delta`, `col_delta`, destroying the objects on the old screen
 */
void shift_screen(int32_t row_delta, int32_t col_delta);

/*
 * Get all the game objects on the currently active screen
 */
screen_t* get_active_screen();
```
